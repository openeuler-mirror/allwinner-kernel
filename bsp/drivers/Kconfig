## bsp/drivers/Kconfig
```kconfig
# SPDX-License-Identifier: GPL-2.0-only

# Minimal System
menu "Device Drivers"
source "$(BSP_TOP)drivers/clk/Kconfig"
source "$(BSP_TOP)drivers/pinctrl/Kconfig"
source "$(BSP_TOP)drivers/uart/Kconfig"
source "$(BSP_TOP)drivers/timer/Kconfig"

# Basic System
source "$(BSP_TOP)drivers/dma/Kconfig"
source "$(BSP_TOP)drivers/rtc/Kconfig"
source "$(BSP_TOP)drivers/bus/Kconfig"
source "$(BSP_TOP)drivers/dumpreg/Kconfig"
source "$(BSP_TOP)drivers/watchdog/Kconfig"
source "$(BSP_TOP)drivers/i2c/Kconfig"
source "$(BSP_TOP)drivers/spi/Kconfig"
source "$(BSP_TOP)drivers/ledc/Kconfig"
source "$(BSP_TOP)drivers/pwm/Kconfig"
source "$(BSP_TOP)drivers/ir-tx/Kconfig"
source "$(BSP_TOP)drivers/ir-rx/Kconfig"
source "$(BSP_TOP)drivers/gpadc/Kconfig"
source "$(BSP_TOP)drivers/lradc/Kconfig"
source "$(BSP_TOP)drivers/rtp/Kconfig"
source "$(BSP_TOP)drivers/usb/Kconfig"
source "$(BSP_TOP)drivers/iommu/Kconfig"
source "$(BSP_TOP)drivers/pcie/Kconfig"
source "$(BSP_TOP)drivers/emac/Kconfig"
source "$(BSP_TOP)drivers/gmac/Kconfig"
source "$(BSP_TOP)drivers/mbus/Kconfig"
source "$(BSP_TOP)drivers/msgbox/Kconfig"
source "$(BSP_TOP)drivers/hwspinlock/Kconfig"

# Power Management
source "$(BSP_TOP)drivers/irqchip/Kconfig"
source "$(BSP_TOP)drivers/standby/Kconfig"
source "$(BSP_TOP)drivers/thermal/Kconfig"
source "$(BSP_TOP)drivers/nvmem/Kconfig"
source "$(BSP_TOP)drivers/pm_domain/Kconfig"
source "$(BSP_TOP)drivers/power/Kconfig"
source "$(BSP_TOP)drivers/cpufreq/Kconfig"
source "$(BSP_TOP)drivers/devfreq/Kconfig"

# Input
source "$(BSP_TOP)drivers/input/Kconfig"

# Storage
source "$(BSP_TOP)drivers/mmc/Kconfig"
source "$(BSP_TOP)modules/nand/Kconfig"

# Graphics
source "$(BSP_TOP)drivers/video/Kconfig"
source "$(BSP_TOP)drivers/g2d/Kconfig"
source "$(BSP_TOP)drivers/di/Kconfig"
source "$(BSP_TOP)drivers/vin/Kconfig"
source "$(BSP_TOP)drivers/vfe/Kconfig"
source "$(BSP_TOP)drivers/tvd/Kconfig"

# Multi-Media
source "$(BSP_TOP)drivers/ve/Kconfig"

# Sound
source "$(BSP_TOP)drivers/sound/Kconfig"

# Security
source "$(BSP_TOP)drivers/smc/Kconfig"
source "$(BSP_TOP)drivers/sid/Kconfig"
source "$(BSP_TOP)drivers/secure_storage/Kconfig"

# Net
source "$(BSP_TOP)drivers/net/Kconfig"

# Wireless
source "$(BSP_TOP)drivers/bluetooth/Kconfig"

# Misc
source "$(BSP_TOP)drivers/misc/Kconfig"

# Drm
source "$(BSP_TOP)drivers/drm/Kconfig"

# Drm heap
source "$(BSP_TOP)drivers/drm_heap/Kconfig"
# Vendor Hoosk
source "$(BSP_TOP)drivers/vendor_hooks/Kconfig"

# Crashdump
source "$(BSP_TOP)drivers/crashdump/Kconfig"

# ATA
source "$(BSP_TOP)drivers/ata/Kconfig"

# MTD
source "$(BSP_TOP)drivers/mtd/Kconfig"

# Remoteproc
source "$(BSP_TOP)drivers/remoteproc/Kconfig"

# Open source GPU
source "$(BSP_TOP)drivers/gpu/Kconfig"

# NPU
source "$(BSP_TOP)drivers/npu/Kconfig"

# redeposit
source "$(BSP_TOP)drivers/redeposit/Kconfig"
endmenu
```

## bsp/drivers/bluetooth/bluetooth_usb_driver/Kconfig
```kconfig
config BT_HCIBTUSB_RTLBTUSB
    tristate "Realtek HCI USB driver support"
    depends on USB
    help
        Realtek Bluetooth HCI USB driver.
        This driver is required if you want to use Realtek Bluetooth
        device with USB interface

        Say Y here to compile support for Bluetooth USB devices into the
        kernel or say M to compile it as module (rtk_btusb).
```

## bsp/drivers/input/keyboard/Kconfig
```kconfig
menuconfig AW_INPUT_KEYBOARD
	bool "Keyboards"
	default y
	help 
		support keyboards

if AW_INPUT_KEYBOARD

config KEYBOARD_SUNXI
        tristate "softwinnner KEY BOARD support"
        help
                Say Y here to enable the keyboard, support 7 keys.
                based on verify board.

endif
```

## bsp/drivers/misc/Kconfig
```kconfig
# SPDX-License-Identifier: GPL-2.0

menu "Misc Devices Drivers"

source "$(BSP_TOP)drivers/misc/sunxi-rf/Kconfig"
source "$(BSP_TOP)drivers/misc/sunxi-addr/Kconfig"
source "$(BSP_TOP)drivers/misc/sunxi-bootevent/Kconfig"

endmenu
```

## bsp/drivers/pcie/Kconfig
```kconfig
# SPDX-License-Identifier: GPL-2.0-only

menu "PCIe Drivers"
	depends on AW_BSP

config SUNXI_PCIE_PLAT
	tristate "Platform bus based Allwiner PCIe Controller"
	depends on AW_BSP
	help
	 This selects the Allwiner PCIe controller support. Select this if
	 you have a PCIe controller on Platform bus.
	 If you have a controller with this interface, say Y or M here.
	 If unsure, say N.

config SUNXI_PCIE
	tristate "Allwinner PCIe controller"
	depends on SUNXI_PCIE_PLAT
	help
	  Enables support for the PCIe controller in the Allwinner SoC.

config SUNXI_PCIE_DMA
	tristate "Allwinner PCIe DMA"
	depends on SUNXI_PCIE
	help
	  Enables support for the PCIe embedded DMA in the Allwinner SoC.


endmenu
```

## bsp/drivers/video/sunxi/disp2/edp2/panels/Kconfig
```kconfig
# SPDX-License-Identifier: GPL-2.0-or-later
config EDP_SUPPORT_VVX10T025J00_2560X1600
	bool "eDP panel support VVX10T025J00_2560X1600"
	default n
	help
		If you want to support VVX10T025J00_2560X1600 panel for edp2 driver, select it.
```
